## firmware/firmware_v0.4_esp_idf/sdkconfig.defaults
```kconfig
# Project-level defaults. Anything here overrides the IDF defaults but is
# still overridable per-checkout via `idf.py menuconfig`.

# The main task (where app_main runs) needs enough stack for the TLS handshake
# during the HTTPS POST to /api/devices/activate. Default 3584 → stack overflow
# during mbedTLS handshake. 10 KB is comfortable headroom.
CONFIG_ESP_MAIN_TASK_STACK_SIZE=10240

# mbedTLS internal stack for handshake work. Default is fine on IDF v5+, but
# some older configs default lower — set explicitly for stability.
CONFIG_MBEDTLS_ASYMMETRIC_CONTENT_LEN=y

# Certificate bundle (required by esp_crt_bundle_attach in activation code)
CONFIG_MBEDTLS_CERTIFICATE_BUNDLE=y
CONFIG_MBEDTLS_CERTIFICATE_BUNDLE_DEFAULT_FULL=y

# The full firmware (WiFi + MQTT + LVGL + LCD + NFC + segmentation) is ~1.3 MB.
# Default partition scheme gives the app only 1 MB. Use the 16MB flash your
# ESP32-S3 board actually has and the "large" partition table (2MB app).
CONFIG_ESPTOOLPY_FLASHSIZE_16MB=y
CONFIG_ESPTOOLPY_FLASHSIZE="16MB"
CONFIG_PARTITION_TABLE_SINGLE_APP_LARGE=y
```
